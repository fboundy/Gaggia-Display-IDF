## sdkconfig.defaults
```kconfig
CONFIG_LV_MEM_CUSTOM=y
CONFIG_LV_MEMCPY_MEMSET_STD=y
CONFIG_LV_USE_USER_DATA=y
CONFIG_LV_USE_CHART=y
CONFIG_LV_USE_PERF_MONITOR=y

# Match board flash size (N16 = 16MB)
CONFIG_ESPTOOLPY_FLASHSIZE_16MB=y
CONFIG_ESPTOOLPY_FLASHSIZE_8MB=n
CONFIG_PARTITION_TABLE_CUSTOM=y

#
# Bluetooth completely disabled (saves IRAM/heap)
#
CONFIG_BT_ENABLED=n
CONFIG_BT_BLUEDROID_ENABLED=n
CONFIG_BT_CLASSIC_ENABLED=n
CONFIG_BT_BLE_ENABLED=n
CONFIG_BT_NIMBLE_ENABLED=n
CONFIG_ESP_COEXIST_ENABLE=n
```
